## boards/shields/aquapad/Kconfig.defconfig
```kconfig
# 
# Kconfig defconfig
# 
# Created: 2025-Aug-09 21:29
# 
# Edited: 2025-Aug-09 21:31

if SHIELD_AQUAPAD

# Name must be less than 16 characters long!
config ZMK_KEYBOARD_NAME
    default "aquaPad"

endif
```

## boards/shields/aquapad/Kconfig.shield
```kconfig
# 
# Kconfig shield
# 
# Created: 2025-Aug-09 21:29
# 
# Edited: 2025-Aug-09 21:31
# 

# No whitespace after the comma or in your keyboard name!
config SHIELD_AQUAPAD
    def_bool $(shields_list_contains,aquapad)
```
